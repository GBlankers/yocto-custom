## build-imx8mm/conf/bblayers.conf
```bitbake
# POKY_BBLAYERS_CONF_VERSION is increased each time build/conf/bblayers.conf
# changes incompatibly
POKY_BBLAYERS_CONF_VERSION = "2"

BBPATH = "${TOPDIR}"
BBFILES ?= ""

BBLAYERS ?= " \
  /home/gblankers/Documenten/Yocto/test-environment/poky/meta \
  /home/gblankers/Documenten/Yocto/test-environment/poky/meta-poky \
  /home/gblankers/Documenten/Yocto/test-environment/poky/meta-yocto-bsp \
  /home/gblankers/Documenten/Yocto/test-environment/meta-openembedded/meta-oe \
  /home/gblankers/Documenten/Yocto/test-environment/meta-openembedded/meta-python \
  /home/gblankers/Documenten/Yocto/test-environment/meta-freescale \
  /home/gblankers/Documenten/Yocto/test-environment/meta-custom \
  /home/gblankers/Documenten/Yocto/test-environment/meta-custom-fsl \
 "
```

## meta-custom-fsl/conf/layer.conf
```bitbake
# We have a conf and classes directory, add to BBPATH
BBPATH .= ":${LAYERDIR}"

# We have recipes-* directories, add to BBFILES
BBFILES += "${LAYERDIR}/recipes-*/*/*.bb \
            ${LAYERDIR}/recipes-*/*/*.bbappend"

BBFILE_COLLECTIONS += "meta-custom-fsl"
BBFILE_PATTERN_meta-custom-fsl = "^${LAYERDIR}/"
BBFILE_PRIORITY_meta-custom-fsl = "6"

LAYERDEPENDS_meta-custom-fsl = "core"
LAYERSERIES_COMPAT_meta-custom-fsl = "kirkstone"
```
